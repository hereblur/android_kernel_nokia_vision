&spi1 {
        #address-cells = <1>;
        #size-cells = <0>;

	qzqchipone@0{
		compatible = "chipone-tddi,fts";
		reg = <0x0>;
		chipone,x-res = <720>;
		chipone,y-res = <1600>;
		spi-max-frequency = <6000000>;
		chipone,rst-gpio = <&ap_gpio 145 GPIO_ACTIVE_HIGH>;
		chipone,irq-gpio = <&ap_gpio 144 GPIO_ACTIVE_HIGH>;
		focaltech,max-touch-number = <5>;			
		focaltech,display-coords =  <0 0 720 1600>;
	};



};
